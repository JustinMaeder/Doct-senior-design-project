#include <TimerOne.h>
#include <SoftwareSerial.h>
#include <SPI.h>
#include <Wire.h>
#include <Adafruit_GFX.h>
#include <Adafruit_SSD1306.h>
static const unsigned char PROGMEM bitmap[]=
{
// 'screen', 128x64px
0x00, 0x00, 0x00, 0x00, 0x00, 0x00, 0x00, 0x00, 0x00, 0x00, 0x00, 0x00, 0x00, 0x00, 0x00, 0x00, 
0x00, 0x00, 0x00, 0x00, 0x00, 0x00, 0x00, 0x00, 0x00, 0x00, 0x00, 0x00, 0x00, 0x00, 0x00, 0x00, 
0x00, 0x00, 0x00, 0x00, 0x00, 0x00, 0x00, 0x00, 0x00, 0x00, 0x00, 0x00, 0x00, 0x00, 0x00, 0x00, 
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0x00, 0x00, 0x00, 0x00, 0x00, 0x00, 0x00, 0x00, 0x00, 0x00, 0x00, 0x00, 0x00, 0x00, 0x00, 0x00
};
#define SCREEN_WIDTH 128 // OLED display width, in pixels
#define SCREEN_HEIGHT 64 // OLED display height, in pixels

// Connect HM10      Arduino Uno
//     Pin 1/TXD          Pin 7
//     Pin 2/RXD          Pin 8
//     SCL                A5 pin
//     SDA                A4 pin
//     VCC                3.3v

char  bt_data,sig;
int16_t mil,batt_lvl; 
String serial_data,spd,batt,range,tim,h,m; 
// Declaration for an SSD1306 display connected to I2C (SDA, SCL pins)
#define OLED_RESET     4 // Reset pin # (or -1 if sharing Arduino reset pin)
Adafruit_SSD1306 display(SCREEN_WIDTH, SCREEN_HEIGHT, &Wire, OLED_RESET);

SoftwareSerial mySerial(7, 8); // RX, TX  
void setup() {  

  Serial.begin(115200);
  mySerial.begin(57600);
  
  if(!display.begin(SSD1306_SWITCHCAPVCC, 0x3C)) { // Address 0x3D for 128x64
    Serial.println(F("SSD1306 allocation failed"));
    for(;;); // Don't proceed, loop forever
  }
  Serial.println("Start");
  display.clearDisplay();
  display.setTextSize(1);      // Normal 1:1 pixel scale
  display.setTextColor(SSD1306_WHITE); // Draw white text
//  display.setCursor(0,0);
//  display.println("Received: ");
  display.drawBitmap(0,0,bitmap,128,64,WHITE);
  display.setCursor(5,54);
  display.print("00");
  display.display();
  
}
//s - ASCII 115 = speed   - 2 digits
//b - ASCII 98  = battery - 2 digits 
//r - ASCII 114 = range   - 2 digits
//t - ASCII 116 = time    - 4 digits
//example: s34b51r23t0940

void loop() {  
  if(mySerial.available()){
    bt_data = mySerial.read();
    if(bt_data == 115){// s-speed
      sig = 1; 
    }
    if(bt_data == 98){ // b-battery
      sig = 2; 
    }
    if(bt_data == 114){// r-range
      sig = 3; 
    }
    if(bt_data == 116){// t-time
      sig = 4; 
    }
    if(sig == 1){
      spd = spd + bt_data;
    }else if(sig == 2){
      batt = batt + bt_data;
    }else if(sig == 3){
      range = range + bt_data;
    }else if(sig == 4){
      tim = tim + bt_data;
    }
    if(bt_data == 10){
      spd = spd.substring(1);  //getting string of number
      batt = batt.substring(1);//getting string of number
      range = range.substring(1);//getting string of number
      tim = tim.substring(1);
      
      set_battery(batt);
      set_speed(spd);
      set_range(range);
      set_time(tim);  
      
      spd = "";
      batt = "";
      range = "";
      tim = "";
      
    }
  }
  display.display();
}

void clr_range(void){
  draw_clrrect(5,54,17,61);
}
void clr_spd(void){
  draw_clrrect(50,27,78,40);
}
void clr_time(void){
  draw_clrrect(6,5,17,11);
  draw_clrrect(21,5,31,11);
}
void draw_clrrect(int16_t x0,int16_t y0,int16_t x1,int16_t y1){
  for(int x = x0;x<=x1;x++){
    for(int y = y0;y<=y1;y++){
      display.drawPixel(x,y,SSD1306_BLACK);
    }
  }
}
void draw_fillrect(int16_t x0,int16_t y0,int16_t x1,int16_t y1){
  for(int x = x0;x<=x1;x++){
    for(int y = y0;y<=y1;y++){
      display.drawPixel(x,y,SSD1306_WHITE);
    }
  }
}
void set_battery(String batt){
  batt_lvl = batt.toInt();
  if(batt_lvl>0 && batt_lvl<=25){
    draw_fillrect(103,6,104,10);
    draw_clrrect(108,6,109,10);
    draw_clrrect(113,6,114,10);
    draw_clrrect(118,6,119,10);
  }if(batt_lvl>26 && batt_lvl<=50){
    draw_fillrect(103,6,104,10);
    draw_fillrect(108,6,109,10);
    draw_clrrect(113,6,114,10);
    draw_clrrect(118,6,119,10);
  }if(batt_lvl>50 && batt_lvl<=75){
    draw_fillrect(103,6,104,10);
    draw_fillrect(108,6,109,10);
    draw_fillrect(113,6,114,10);
    draw_clrrect(118,6,119,10);
  }if(batt_lvl>75 && batt_lvl<=100){
    draw_fillrect(103,6,104,10);
    draw_fillrect(108,6,109,10);
    draw_fillrect(113,6,114,10);
    draw_fillrect(118,6,119,10);
  }
}
void set_range(String range){
  clr_range(); 
  display.setTextColor(SSD1306_WHITE);
  display.setTextSize(1);
  display.setCursor(5,54);
  display.print(range);
}
void set_speed(String spd){
  clr_spd();
  display.setTextColor(SSD1306_WHITE);
  display.setTextSize(2);
  display.setCursor(53,27);
  display.print(spd);  
}=

void set_time(String t){
  clr_time();
  h = t.substring(0,2);
  m = t.substring(2);
  display.setTextColor(SSD1306_WHITE);
  display.setTextSize(1);
  display.setCursor(7,5);
  display.print(h);
  display.setCursor(21,5);
  display.print(m);
}
